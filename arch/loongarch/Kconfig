## arch/loongarch/Kconfig
```kconfig
# SPDX-License-Identifier: Apache-2.0
#
# Copyright 2024 Loongson Technology Corporation Limited
#

if ARCH_LOONGARCH

choice
	prompt "LoongArch Toolchain Selection"
	default LOONGARCH_TOOLCHAIN_GNU

config LOONGARCH_TOOLCHAIN_GNU
	bool "Generic GNU toolchain"
	select ARCH_TOOLCHAIN_GCC
	---help---
		This option should work for any modern GNU toolchain (GCC 5.2 or newer)
		configured for loongarch64-unknown-elf.

endchoice # LoongArch Toolchain Selection

choice
	prompt "LoongArch Chip Selection"
	default ARCH_CHIP_LS2K0300
	depends on ARCH_LOONGARCH

config ARCH_CHIP_LS2K0300
	bool "LS2K0300"
	select ARCH_HAVE_DPFPU
	select LS_HAVE_I2C0
	select LS_HAVE_I2C1
	select LS_HAVE_I2C2
	select LS_HAVE_I2C3
	select LS_HAVE_TIM1
	select LS_HAVE_TIM2
	select LS_HAVE_TIM6
	select LS_HAVE_DMA1
	select LS_HAVE_ADC1
	select LS_HAVE_COMMON_FOC
	select LS_HAVE_IP_TIMERS
	---help---
		Loongson LS2K0300 SoC, LoongArch 64-bit

endchoice

config ARCH_CHIP
	string
	default "ls2k" if ARCH_CHIP_LS2K0300

config ARCH_LOONGARCH64
	bool
	default y if ARCH_LOONGARCH
	select ARCH_HAVE_STACKCHECK

source "arch/loongarch/src/ls2k/Kconfig"

endif
```

## arch/loongarch/src/ls2k/Kconfig
```kconfig
comment "LS Configuration Options"

menu "LS Peripheral Support"

source "arch/loongarch/src/ls2k/Kconfig.have"

source "arch/loongarch/src/ls2k/Kconfig.periph"

config LS_RTC
	bool "RTC"
	default n
	select RTC
	select RTC_DATETIME
	select RTC_DRIVER
	select RTC_ARCH
	---help---
		Enable RTC driver support

config LS_WDT
	bool "Watchdog"
	default n
	select WATCHDOG
	---help---
		Enable watchdog timer driver support

config LS_GPIO
	bool "GPIO"
	default n
	select DEV_GPIO
	---help---
		Enable GPIO driver support

endmenu
```

## arch/loongarch/src/ls2k/Kconfig.adc
```kconfig
#
# STM32 ADC configuration options.
#

# TODO: The options below are a special case for the legacy family-local
# stm32l4_adc.c driver (selected by LS_HAVE_ADC_L4).  They must be migrated
# to the common ADC interface used by stm32_adc_m3m4_v1v2.c (LS_ADCx_EXTSEL /
# LS_ADCx_JEXTSEL / LS_ADCx_INJECTED_CHAN) and removed from here.

config LS_ADC1_HAVE_TIMER_FREQ
	bool
	default y if LS_TIM && LS_ADC1_HAVE_TIMER

config LS_ADC1_HAVE_TIMTRIG
	bool
	default y if LS_TIM && LS_ADC1_HAVE_TIMER

config LS_ADC1_HAVE_DMA
	bool

config LS_ADC1_HAVE_OUTPUT_DFSDM
	bool

config LS_ADC1_HAVE_TIMER
	bool

config LS_ADC1_SAMPLE_FREQUENCY
	int "ADC1 Sampling Frequency"
	depends on LS_ADC1_HAVE_TIMER_FREQ
	default 100
	---help---
		ADC1 sampling frequency.  Default:  100Hz

config LS_ADC1_TIMTRIG
	int "ADC1 Timer Trigger"
	depends on LS_ADC1_HAVE_TIMTRIG
	default 0
	range 0 4 if LS_HAVE_ADC_TIMTRIG_TRGO
	---help---
		Values 0:CC1 1:CC2 2:CC3 3:CC4 4:TRGO

config LS_ADC_MAX_SAMPLES
	int "The maximum number of channels that can be sampled"
	depends on LS_ADC
	default 1 if !LS_ADC1_DMA
	default 16
	---help---
		The maximum number of samples which can be handled without
		overrun depends on various factors. This is the user's
		responsibility to correctly select this value.
		Since the interface to update the sampling time is available
		for all supported devices, the user can change the default
		values in the board initialization logic and avoid ADC overrun.

config LS_ADC_NO_STARTUP_CONV
	bool "Do not start conversion when opening ADC device"
	depends on LS_ADC
	---help---
		Do not start conversion when opening ADC device.

config LS_ADC_NOIRQ
	bool "Do not use default ADC interrupts"
	depends on LS_ADC
	---help---
		Do not use default ADC interrupts handlers.

config LS_ADC_LL_OPS
	bool "ADC low-level operations"
	depends on LS_ADC
	---help---
		Enable low-level ADC ops.

config LS_ADC_CHANGE_SAMPLETIME
	bool "ADC sample time configuration"
	depends on LS_ADC_LL_OPS
	---help---
		Enable ADC sample time configuration (SMPRx registers).

config LS_ADC_OVERSAMPLE
	bool "Enable ADC hardware oversampling support"
	depends on LS_ADC1 && LS_HAVE_ADC_OVERSAMPLE
	---help---
		Enable the on-chip ADC oversampling/accumulation block (CFGR2.OVSE).
		Only STM32G0 and STM32L0 series include this hardware block.

config LS_ADC1_DMA
	bool "ADC1 DMA"
	depends on LS_ADC && LS_ADC1 && LS_ADC1_HAVE_DMA
	---help---
		If DMA is selected, then the ADC may be configured to support
		DMA transfer, which is necessary if multiple channels are read
		or if very high trigger frequencies are used.

config LS_ADC1_SCAN
	bool "ADC1 scan mode"
	depends on (LS_ADC && LS_ADC1)
	default LS_ADC1_DMA

config LS_ADC1_DMA_BATCH
	int "ADC1 DMA number of conversions"
	depends on LS_ADC && LS_ADC1 && LS_ADC1_DMA
	default 1
	---help---
		This option allows you to select the number of regular group conversions
		that will trigger a DMA callback transerring data to the upper-half driver.
		By default, this value is 1, which means that data is transferred after
		each group conversion.

config LS_ADC1_ANIOC_TRIGGER
	int "ADC1 software trigger (ANIOC_TRIGGER) configuration"
	depends on (LS_ADC && LS_ADC1)
	default 3
	range 1 3
	---help---
		1 - ANIOC_TRIGGER only starts regular conversion
		2 - ANIOC_TRIGGER only starts injected conversion
		3 - ANIOC_TRIGGER starts both regular and injected conversions

config LS_ADC1_INJECTED_CHAN
	int "ADC1 injected channels"
	depends on (LS_ADC && LS_ADC1)
	default 0
	range 0 4
	---help---
		Support for ADC1 injected channels.

config LS_ADC1_EXTSEL
	bool "ADC1 external trigger for regular group"
	depends on LS_ADC && LS_ADC1 && !LS_ADC1_HAVE_TIMER
	---help---
		Enable EXTSEL for ADC1.

config LS_ADC1_JEXTSEL
	bool "ADC1 external trigger for injected group"
	depends on (LS_ADC && LS_ADC1)
	---help---
		Enable JEXTSEL for ADC1.

config LS_ADC1_OUTPUT_DFSDM
	bool "ADC1 output to DFSDM"
	depends on LS_ADC1_HAVE_OUTPUT_DFSDM && LS_ADC1 && LS_DFSDM1
	---help---
		Route ADC1 output directly to DFSDM parallel inputs.

config LS_ADC1_CONTINUOUS
	bool "Enable ADC1 Continuous Conversion Mode"
	default n
	depends on LS_ADC1
	---help---
		If enabled, the ADC will operate in continuous conversion mode.
		Otherwise, it will perform single conversions.
		Note: Continuous and discontinuous mode cannot be defined at
		      the same time
```

## arch/loongarch/src/ls2k/Kconfig.foc
```kconfig
#
# LS common FOC options.
#

config LS_FOC_HAVE_ADC_CHAN0_WORKAROUND
	bool

config LS_FOC_USE_TIM1
	bool
	select LS_TIM1
	select LS_TIM1_PWM
	select LS_TIM1_CHANNEL1
	select LS_TIM1_CHANNEL2
	select LS_TIM1_CHANNEL3
	select LS_TIM1_CHANNEL4 if LS_FOC_ADC_CCR4
	select LS_TIM1_CH1OUT
	select LS_TIM1_CH2OUT
	select LS_TIM1_CH3OUT
	select LS_TIM1_CH4OUT if LS_FOC_ADC_CCR4
	select LS_TIM1_CH1NOUT if LS_FOC_HAS_PWM_COMPLEMENTARY
	select LS_TIM1_CH2NOUT if LS_FOC_HAS_PWM_COMPLEMENTARY
	select LS_TIM1_CH3NOUT if LS_FOC_HAS_PWM_COMPLEMENTARY
	---help---
		The TIM1 generates PWM for the FOC

config LS_FOC_USE_ADC1
	bool
	select LS_ADC1
	select LS_ADC1_SCAN if ARCH_CHIP_LSF7 || LS_HAVE_IP_ADC_M3M4_V1
	select LS_ADC1_JEXTSEL

#
#

choice
	prompt "FOC ADC trigger selection"
	depends on LS_FOC
	default LS_FOC_ADC_TRGO

config LS_FOC_ADC_CCR4
	bool "FOC uses CCR4 as ADC trigger"
	---help---
		This option uses the software frequency prescaler and is
		not possible for 4-phase output.

config LS_FOC_ADC_TRGO
	bool "FOC uses TRGO as ADC trigger"
	depends on !LS_FOC_FOC1
	select LS_PWM_TRGO
	---help---
		This option allows you to use higher PWM frequency and works for 4-phase output.
		It is not possible for ADC IPv1 if FOC1 enabled (no T8TRGO in JEXTSEL).

endchoice # "FOC ADC trigger selection"

choice
	prompt "FOC0 device ADC selection"
	depends on LS_FOC_FOC0
	default LS_FOC_FOC0_ADC1

config LS_FOC_FOC0_ADC1
	bool "FOC0 uses ADC1"
	depends on LS_HAVE_ADC1
	select LS_FOC_USE_ADC1

endchoice # "FOC0 device ADC selection"

menuconfig LS_FOC
	bool "LS lower-half FOC support"
	depends on LS_HAVE_COMMON_FOC
	depends on MOTOR_FOC
	select ARCH_IRQPRIO
	select LS_ADC
	select LS_PWM_MULTICHAN
	select LS_PWM_LL_OPS
	select LS_ADC_LL_OPS
	select LS_ADC_CHANGE_SAMPLETIME
	select LS_ADC_NO_STARTUP_CONV

config LS_FOC_FOC0
	bool "FOC0 device (TIM1 for PWM modulation)"
	depends on LS_FOC && LS_HAVE_TIM1
	select LS_FOC_USE_TIM1
	---help---
		Enable support for FOC0 device that uses TIM1 for PWM modulation

config LS_FOC_HAS_PWM_COMPLEMENTARY
	bool "FOC PWM has complementary outputs"
	depends on LS_FOC
	---help---
		Enable complementary outputs for the FOC PWM (sometimes called 6-PWM mode)
```

## arch/loongarch/src/ls2k/Kconfig.i2c
```kconfig
#
# LS I2C configuration options.
#

config LS_I2C_SLAVE
	bool
	default n

config LS_I2C_DYNTIMEO
	bool "Use dynamic timeouts"
	depends on LS_I2C

config LS_I2C_DYNTIMEO_USECPERBYTE
	int "Timeout Microseconds per Byte"
	depends on LS_I2C && LS_I2C_DYNTIMEO
	default 500

config LS_I2C_DYNTIMEO_STARTSTOP
	int "Timeout for Start/Stop (Milliseconds)"
	depends on LS_I2C && LS_I2C_DYNTIMEO
	default 1000

config LS_I2CTIMEOSEC
	int "Timeout seconds"
	depends on LS_I2C
	default 0

config LS_I2CTIMEOMS
	int "Timeout Milliseconds"
	depends on LS_I2C && !LS_I2C_DYNTIMEO
	default 500

config LS_I2CTIMEOTICKS
	int "Timeout for Done and Stop (ticks)"
	depends on LS_I2C && !LS_I2C_DYNTIMEO
	default 500

config LS_I2C_DUTY16_9
	bool "Frequency with Tlow/Thigh = 16/9"
	default n
	depends on LS_I2C && LS_COMMON_LEGACY

config LS_I2C_DMA
	bool "I2C DMA Support"
	default n
	depends on LS_I2C && LS_DMA1 && !I2C_POLLED
	---help---
		This option enables the DMA for I2C transfers.
		Note: The user can define CONFIG_I2C_DMAPRIO: a custom priority value for the
		I2C dma streams, else the default priority level is set to medium.

menu "I2C Slave Configuration"
	depends on LS_I2C_SLAVE

config LS_I2C_SLAVE_DEFAULT_TX
	hex "Default TX byte to be sent when the TX buffer is empty"
	default 0xFF

config LS_I2C_SLAVE_USEWQ
	bool "Use work queue to delegate the isr completion status"
	default n
	---help---
		With the current upperhalf I2C slave driver implementation, the user
		should delegate the callback completion status using a work queue.
		However, work queues introduce a delay, so in certain scenarios
		it is better to use a custom driver without using a work queue.

config LS_I2C_SLAVE_RETRANSFER
	bool "The frame is retransferred when stop is issued beforehand"
	default n
	---help---
		If stop is issued before the whole frame is transferred,
		the tx pointer is reset to 0.

endmenu
```

## arch/loongarch/src/ls2k/Kconfig.periph
```kconfig
#
# LS common peripheral selection options.
#

menu "LS Peripheral Support"


endmenu # LS Peripheral Support
```
